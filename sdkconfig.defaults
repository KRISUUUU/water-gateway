## sdkconfig.defaults
```kconfig
# =============================================================
# water-gateway sdkconfig.defaults
# =============================================================
# NOTE:
# - This file reflects development-friendly defaults.
# - Production hardening (Secure Boot / Flash Encryption / NVS encryption /
#   anti-rollback policy) must be applied in a dedicated release profile and
#   provisioning process.
# - Repository defaults intentionally do not enable Secure Boot, Flash
#   Encryption, or anti-rollback. Treat this file as non-production baseline.

# Flash
CONFIG_ESPTOOLPY_FLASHSIZE_4MB=y
CONFIG_ESPTOOLPY_FLASHMODE_DIO=y
CONFIG_ESPTOOLPY_FLASHFREQ_40M=y

# Partition table
CONFIG_PARTITION_TABLE_CUSTOM=y
CONFIG_PARTITION_TABLE_CUSTOM_FILENAME="partitions.csv"
CONFIG_PARTITION_TABLE_FILENAME="partitions.csv"

# Bootloader
CONFIG_BOOTLOADER_APP_ROLLBACK_ENABLE=y
CONFIG_BOOTLOADER_LOG_LEVEL_WARN=y

# Logging
CONFIG_LOG_DEFAULT_LEVEL_DEBUG=y
CONFIG_LOG_MAXIMUM_LEVEL_DEBUG=y

# FreeRTOS
CONFIG_FREERTOS_HZ=1000
CONFIG_FREERTOS_TIMER_TASK_STACK_DEPTH=3072
CONFIG_FREERTOS_USE_TRACE_FACILITY=y
CONFIG_FREERTOS_GENERATE_RUN_TIME_STATS=y
CONFIG_ESP_MAIN_TASK_STACK_SIZE=6144

# C++ support
CONFIG_COMPILER_CXX_EXCEPTIONS=n
CONFIG_COMPILER_CXX_RTTI=n

# WiFi
CONFIG_ESP_WIFI_SOFTAP_SUPPORT=y

# LWIP / Networking
CONFIG_LWIP_DNS_SUPPORT_MDNS_QUERIES=y
CONFIG_LWIP_MAX_SOCKETS=10

# mDNS
CONFIG_MDNS_MAX_INTERFACES=3

# HTTP server
CONFIG_HTTPD_TASK_STACK_SIZE=16384
CONFIG_HTTPD_RECV_WAIT_TIMEOUT=30
CONFIG_HTTPD_SEND_WAIT_TIMEOUT=30
CONFIG_HTTPD_MAX_REQ_HDR_LEN=1024
CONFIG_HTTPD_MAX_URI_LEN=512

# MQTT (ESP-IDF mqtt component)
CONFIG_MQTT_TRANSPORT_SSL=y
CONFIG_MQTT_BUFFER_SIZE=2048
CONFIG_MQTT_TASK_STACK_SIZE=6144

# SPI
CONFIG_SPI_MASTER_IN_IRAM=y

# NVS
CONFIG_NVS_ENCRYPTION=n

# SPIFFS
CONFIG_SPIFFS_MAX_PARTITIONS=1

# Watchdog
CONFIG_ESP_TASK_WDT_EN=y
CONFIG_ESP_TASK_WDT_TIMEOUT_S=30

# mbedTLS (needed for SHA-256 password hashing and optional TLS)
CONFIG_MBEDTLS_HARDWARE_SHA=y

# Stack overflow detection
CONFIG_FREERTOS_CHECK_STACKOVERFLOW_CANARY=y

# Heap debugging (can be disabled in production builds)
CONFIG_HEAP_TRACING_OFF=y
```
